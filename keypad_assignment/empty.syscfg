/**
 * @cliArgs --device "MSPM0G350X" --part "Default" --package "LQFP-64(PM)" --product "mspm0_sdk@2.03.00.08"
 * @versions {"tool":"1.22.0+3893"}
 */

/**
 * Import the modules used in this configuration.
 */
const GPIO   = scripting.addModule("/ti/driverlib/GPIO", {}, false);
const GPIO1  = GPIO.addInstance();
const GPIO2  = GPIO.addInstance();
const GPIO3  = GPIO.addInstance();
const SYSCTL = scripting.addModule("/ti/driverlib/SYSCTL");

/**
 * Write custom configuration values to the imported modules.
 */
GPIO1.port                          = "PORTB";
GPIO1.$name                         = "GPIO_PORT_B";
GPIO1.associatedPins.create(5);
GPIO1.associatedPins[0].$name       = "PIN_0";
GPIO1.associatedPins[0].assignedPin = "8";
GPIO1.associatedPins[1].$name       = "PIN_1";
GPIO1.associatedPins[1].assignedPin = "7";
GPIO1.associatedPins[2].$name       = "PIN_2";
GPIO1.associatedPins[2].assignedPin = "6";
GPIO1.associatedPins[3].$name       = "PIN_3";
GPIO1.associatedPins[3].assignedPin = "0";
GPIO1.associatedPins[4].$name       = "PIN_4";
GPIO1.associatedPins[4].assignedPin = "16";

const Board = scripting.addModule("/ti/driverlib/Board", {}, false);

GPIO2.port                               = "PORTA";
GPIO2.$name                              = "GPIO_PORT_A";
GPIO2.associatedPins.create(4);
GPIO2.associatedPins[0].$name            = "PIN_5";
GPIO2.associatedPins[0].direction        = "INPUT";
GPIO2.associatedPins[0].internalResistor = "PULL_UP";
GPIO2.associatedPins[0].assignedPin      = "8";
GPIO2.associatedPins[1].$name            = "PIN_6";
GPIO2.associatedPins[1].assignedPin      = "12";
GPIO2.associatedPins[1].direction        = "INPUT";
GPIO2.associatedPins[1].internalResistor = "PULL_UP";
GPIO2.associatedPins[2].$name            = "PIN_7";
GPIO2.associatedPins[2].assignedPin      = "31";
GPIO2.associatedPins[2].direction        = "INPUT";
GPIO2.associatedPins[2].internalResistor = "PULL_UP";
GPIO2.associatedPins[3].$name            = "PIN_8";
GPIO2.associatedPins[3].assignedPin      = "13";
GPIO2.associatedPins[3].direction        = "INPUT";
GPIO2.associatedPins[3].internalResistor = "PULL_UP";

GPIO3.$name                          = "GPIO_PORT_C";
GPIO3.associatedPins[0].$name        = "PIN_9";
GPIO3.associatedPins[0].assignedPort = "PORTB";
GPIO3.associatedPins[0].assignedPin  = "22";

SYSCTL.forceDefaultClkConfig = true;

/**
 * Pinmux solution for unlocked pins/peripherals. This ensures that minor changes to the automatic solver in a future
 * version of the tool will not impact the pinmux you originally saw.  These lines can be completely deleted in order to
 * re-solve from scratch.
 */
GPIO1.associatedPins[0].pin.$suggestSolution = "PB8";
GPIO1.associatedPins[1].pin.$suggestSolution = "PB7";
GPIO1.associatedPins[2].pin.$suggestSolution = "PB6";
GPIO1.associatedPins[3].pin.$suggestSolution = "PB0";
GPIO1.associatedPins[4].pin.$suggestSolution = "PB16";
Board.peripheral.$suggestSolution            = "DEBUGSS";
Board.peripheral.swclkPin.$suggestSolution   = "PA20";
Board.peripheral.swdioPin.$suggestSolution   = "PA19";
GPIO2.associatedPins[0].pin.$suggestSolution = "PA8";
GPIO2.associatedPins[1].pin.$suggestSolution = "PA12";
GPIO2.associatedPins[2].pin.$suggestSolution = "PA31";
GPIO2.associatedPins[3].pin.$suggestSolution = "PA13";
GPIO3.associatedPins[0].pin.$suggestSolution = "PB22";
SYSCTL.peripheral.$suggestSolution           = "SYSCTL";

/**
 * @cliArgs --device "MSPM0G350X" --part "Default" --package "LQFP-64(PM)" --product "mspm0_sdk@2.03.00.08"
 * @versions {"tool":"1.22.0+3893"}
 */

/**
 * Import the modules used in this configuration.
 */
const GPIO   = scripting.addModule("/ti/driverlib/GPIO", {}, false);
const GPIO1  = GPIO.addInstance();
const GPIO2  = GPIO.addInstance();
const SYSCTL = scripting.addModule("/ti/driverlib/SYSCTL");

/**
 * Write custom configuration values to the imported modules.
 */
GPIO1.port                          = "PORTB";
GPIO1.$name                         = "GPIO_SWITCH";
GPIO1.associatedPins[0].$name       = "PIN_1";
GPIO1.associatedPins[0].assignedPin = "21";
GPIO1.associatedPins[0].direction   = "INPUT";

const Board = scripting.addModule("/ti/driverlib/Board", {}, false);

GPIO2.port                          = "PORTB";
GPIO2.$name                         = "GPIO_LED";
GPIO2.associatedPins[0].$name       = "USER_LED_1";
GPIO2.associatedPins[0].assignedPin = "27";

SYSCTL.forceDefaultClkConfig = true;

/**
 * Pinmux solution for unlocked pins/peripherals. This ensures that minor changes to the automatic solver in a future
 * version of the tool will not impact the pinmux you originally saw.  These lines can be completely deleted in order to
 * re-solve from scratch.
 */
GPIO1.associatedPins[0].pin.$suggestSolution = "PB21";
Board.peripheral.$suggestSolution            = "DEBUGSS";
Board.peripheral.swclkPin.$suggestSolution   = "PA20";
Board.peripheral.swdioPin.$suggestSolution   = "PA19";
GPIO2.associatedPins[0].pin.$suggestSolution = "PB27";
SYSCTL.peripheral.$suggestSolution           = "SYSCTL";

/**
 * @cliArgs --device "MSPM0G350X" --part "Default" --package "LQFP-64(PM)" --product "mspm0_sdk@2.03.00.08"
 * @versions {"tool":"1.22.0+3893"}
 */

/**
 * Import the modules used in this configuration.
 */
const GPIO   = scripting.addModule("/ti/driverlib/GPIO", {}, false);
const GPIO1  = GPIO.addInstance();
const PWM    = scripting.addModule("/ti/driverlib/PWM", {}, false);
const PWM1   = PWM.addInstance();
const SYSCTL = scripting.addModule("/ti/driverlib/SYSCTL");

/**
 * Write custom configuration values to the imported modules.
 */
GPIO1.$name                              = "GPIO_SWITCH";
GPIO1.associatedPins.create(2);
GPIO1.associatedPins[0].direction        = "INPUT";
GPIO1.associatedPins[0].interruptEn      = true;
GPIO1.associatedPins[0].polarity         = "FALL";
GPIO1.associatedPins[0].$name            = "SW_1";
GPIO1.associatedPins[0].assignedPort     = "PORTA";
GPIO1.associatedPins[0].assignedPin      = "18";
GPIO1.associatedPins[1].$name            = "SW_2";
GPIO1.associatedPins[1].direction        = "INPUT";
GPIO1.associatedPins[1].assignedPort     = "PORTB";
GPIO1.associatedPins[1].assignedPin      = "21";
GPIO1.associatedPins[1].internalResistor = "PULL_UP";

const Board = scripting.addModule("/ti/driverlib/Board", {}, false);

PWM1.$name                              = "PWM_0";
PWM1.clockSource                        = "LFCLK";
PWM1.pwmMode                            = "CENTER_ALIGN";
PWM1.ccIndex                            = [0];
PWM1.clockPrescale                      = 3;
PWM1.peripheral.$assign                 = "TIMG0";
PWM1.PWM_CHANNEL_0.$name                = "ti_driverlib_pwm_PWMTimerCC0";
PWM1.PWM_CHANNEL_0.dutyCycle            = 10;
PWM1.ccp0PinConfig.$name                = "ti_driverlib_gpio_GPIOPinGeneric0";
PWM1.ccp0PinConfig.direction            = scripting.forceWrite("OUTPUT");
PWM1.ccp0PinConfig.hideOutputInversion  = scripting.forceWrite(false);
PWM1.ccp0PinConfig.onlyInternalResistor = scripting.forceWrite(false);
PWM1.ccp0PinConfig.passedPeripheralType = scripting.forceWrite("Digital");

SYSCTL.forceDefaultClkConfig = true;

/**
 * Pinmux solution for unlocked pins/peripherals. This ensures that minor changes to the automatic solver in a future
 * version of the tool will not impact the pinmux you originally saw.  These lines can be completely deleted in order to
 * re-solve from scratch.
 */
GPIO1.associatedPins[0].pin.$suggestSolution = "PA18";
GPIO1.associatedPins[1].pin.$suggestSolution = "PB21";
Board.peripheral.$suggestSolution            = "DEBUGSS";
Board.peripheral.swclkPin.$suggestSolution   = "PA20";
Board.peripheral.swdioPin.$suggestSolution   = "PA19";
PWM1.peripheral.ccp0Pin.$suggestSolution     = "PA12";
SYSCTL.peripheral.$suggestSolution           = "SYSCTL";

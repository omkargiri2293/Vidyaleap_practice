/**
 * @cliArgs --device "MSPM0G350X" --part "Default" --package "LQFP-64(PM)" --product "mspm0_sdk@2.04.00.06"
 * @versions {"tool":"1.22.0+3893"}
 */

/**
 * Import the modules used in this configuration.
 */
const CAPTURE  = scripting.addModule("/ti/driverlib/CAPTURE", {}, false);
const CAPTURE1 = CAPTURE.addInstance();
const GPIO     = scripting.addModule("/ti/driverlib/GPIO", {}, false);
const GPIO1    = GPIO.addInstance();
const GPIO2    = GPIO.addInstance();
const SYSCTL   = scripting.addModule("/ti/driverlib/SYSCTL");

/**
 * Write custom configuration values to the imported modules.
 */
CAPTURE1.interrupts                         = ["CC0_DN"];
CAPTURE1.timerClkPrescale                   = 32;
CAPTURE1.timerClkSrc                        = "LFCLK";
CAPTURE1.timerPeriod                        = "8000 ms";
CAPTURE1.captEdgeDetection                  = "FALLING";
CAPTURE1.$name                              = "CAPTURE_0";
CAPTURE1.peripheral.$assign                 = "TIMG0";
CAPTURE1.ccp0PinConfig.$name                = "ti_driverlib_gpio_GPIOPinGeneric0";
CAPTURE1.ccp0PinConfig.hideOutputInversion  = scripting.forceWrite(false);
CAPTURE1.ccp0PinConfig.onlyInternalResistor = scripting.forceWrite(false);
CAPTURE1.ccp0PinConfig.passedPeripheralType = scripting.forceWrite("Digital");

const Board = scripting.addModule("/ti/driverlib/Board", {}, false);

GPIO1.$name                          = "GPIO_LED";
GPIO1.associatedPins[0].$name        = "LED_1";
GPIO1.associatedPins[0].assignedPort = "PORTA";
GPIO1.associatedPins[0].assignedPin  = "0";
GPIO1.associatedPins[0].invert       = "ENABLE";

GPIO2.$name                              = "GPIO_SWITCH";
GPIO2.associatedPins[0].$name            = "SW_1";
GPIO2.associatedPins[0].direction        = "INPUT";
GPIO2.associatedPins[0].assignedPort     = "PORTA";
GPIO2.associatedPins[0].assignedPin      = "18";
GPIO2.associatedPins[0].polarity         = "RISE_FALL";
GPIO2.associatedPins[0].internalResistor = "PULL_DOWN";
GPIO2.associatedPins[0].interruptEn      = true;

SYSCTL.forceDefaultClkConfig = true;

/**
 * Pinmux solution for unlocked pins/peripherals. This ensures that minor changes to the automatic solver in a future
 * version of the tool will not impact the pinmux you originally saw.  These lines can be completely deleted in order to
 * re-solve from scratch.
 */
CAPTURE1.peripheral.ccp0Pin.$suggestSolution = "PA12";
Board.peripheral.$suggestSolution            = "DEBUGSS";
Board.peripheral.swclkPin.$suggestSolution   = "PA20";
Board.peripheral.swdioPin.$suggestSolution   = "PA19";
GPIO1.associatedPins[0].pin.$suggestSolution = "PA0";
GPIO2.associatedPins[0].pin.$suggestSolution = "PA18";
SYSCTL.peripheral.$suggestSolution           = "SYSCTL";
